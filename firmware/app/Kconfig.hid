## firmware/app/Kconfig.hid
```kconfig
menuconfig APP_HID
  bool "HID config"
  default y

if APP_HID

config APP_HID_MAX_MSG_SIZE
  int "Max message size"
  default 64

config APP_HID_QUEUE_SIZE
  int "Message queue size"
  default 8

endif # APP_HID
```

## firmware/app/Kconfig.ui
```kconfig
menuconfig APP_UI
  bool "UI config"
  default y

if APP_UI

config APP_UI_SUB_QUEUE_SIZE
  int "UI subscriber queue size"
  default 4

config APP_UI_THREAD_STACK_SIZE
  int "UI thread stack size"
  default 4096

config APP_UI_THREAD_PRIORITY
  int "UI thread priority"
  default 5

menuconfig APP_UI_LED
  bool "LED"
  default y

if APP_UI_LED

choice
  prompt "Pattern"
  default APP_UI_LED_STATIC

config APP_UI_LED_STATIC
  bool "Static"

config APP_UI_LED_MOSAIC
  bool "Mosaic"

endchoice # APP_UI_LED

config APP_UI_STATIC_LED_ACTIVE_COLOR
  hex "Color for active LED (uint32)"
  default 0x770737

config APP_UI_STATIC_LED_INACTIVE_COLOR
  hex "Color for inactive LED (uint32)"
  default 0x070e77

config APP_UI_LED_BRIGHTNESS
  hex "LED brightness from 0 to 100"
  default 10

endif # APP_UI_LED

endif # APP_UI
```

## firmware/app/boards/h4ptix_display.conf
```kconfig
CONFIG_HEAP_MEM_POOL_SIZE=16384
CONFIG_CFB_LOG_LEVEL_DBG=y
CONFIG_CHARACTER_FRAMEBUFFER=y
CONFIG_CHARACTER_FRAMEBUFFER_USE_DEFAULT_FONTS=n
```

## firmware/boards/h4ptix/Kconfig.defconfig
```kconfig
if BOARD_H4PTIX

if I2C_DW

config I2C_DW_CLOCK_SPEED
  default 125

endif # I2C_DW

endif # BOARD_H4PTIX
```

## firmware/boards/h4ptix/board.yml
```yaml
board:
  name: h4ptix
  full_name: H3ptiX
  socs:
  - name: rp2040
    variants:
    - name: basic
    - name: display
    - name: matrix
```

## firmware/boards/h4ptix/h4ptix_display_defconfig
```kconfig
CONFIG_SYS_CLOCK_HW_CYCLES_PER_SEC=125000000
CONFIG_SERIAL=y
CONFIG_CONSOLE=y
CONFIG_UART_CONSOLE=y
CONFIG_GPIO=y
CONFIG_USE_DT_CODE_PARTITION=y
CONFIG_BUILD_OUTPUT_UF2=y
CONFIG_BUILD_OUTPUT_HEX=y
CONFIG_UART_INTERRUPT_DRIVEN=y
CONFIG_RESET=y
CONFIG_CLOCK_CONTROL=y

# display support
CONFIG_I2C=y
CONFIG_DISPLAY=y
CONFIG_SSD1306=y
CONFIG_SSD1306_DEFAULT_CONTRAST=128
```

## firmware/drivers/gpio_trigger/Kconfig
```kconfig
menuconfig GPIO_TRIGGER
  bool "GPIO trigger"
  default y

if GPIO_TRIGGER

module = GPIO_TRIGGER
module-str = gpio-trigger
source "subsys/logging/Kconfig.template.log_config"

config GPIO_TRIGGER_INIT_PRIORITY
  int "Trigger initialization priority"
  default 90

endif # GPIO_TRIGGER
```

## firmware/dts/bindings/trigger/gpio_trigger.yaml
```yaml
description: GPIO pin to trigger capacitive touch

compatible: "gpio-trigger"

include: base.yaml

child-binding:
  description: GPIO trigger child node
  properties:
    gpios:
      type: phandle-array
      required: true
      description: |
        The GPIO connected to the capacitive touch optocoupler.
```

## firmware/lib/uarti/Kconfig
```kconfig
menuconfig UARTI
  bool "UARTI config"
  default y

if UARTI

module = UARTI
module-str = uarti
source "subsys/logging/Kconfig.template.log_config"

config UARTI_TIMEOUT
  int "Timeout waiting for a rest of a message in ms"
  default 150

config UARTI_RX_QUEUE_SIZE
  int "RX message queue size"
  default 8

config UARTI_RX_BUFFER_SIZE
  int "Buffer size in bytes for RX buffer"
  default 512

config UARTI_TX_BUFFER_SIZE
  int "Buffer size in bytes for TX buffer"
  default 1024

config UARTI_INITIALIZE_AT_BOOT
  bool "Initialize the UARTI subsystem automacitlly"
  default y

config UARTI_INIT_PRIORITY
  int "Initialization priority"
  default 80
  range 0 99

endif # UARTI
```

## firmware/west.yml
```yaml
# https://docs.zephyrproject.org/4.1.0/develop/west/manifest.html

manifest:
  #version: 0.1

  remotes:
    - name: zephyr
      url-base: https://github.com/zephyrproject-rtos

  group-filter:
    - +optional

  projects:
    - name: zephyr
      remote: zephyr
      repo-path: zephyr
      revision: v4.1.0
      clone-depth: 1
      import:
        name-allowlist:
          - cmsis
          - hal_rpi_pico
          - nanopb
```
